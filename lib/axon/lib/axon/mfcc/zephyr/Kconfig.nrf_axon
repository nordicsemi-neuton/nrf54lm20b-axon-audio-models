## lib/axon/lib/axon/mfcc/zephyr/Kconfig.nrf_axon
```kconfig
#
# Copyright (c) 2024 Nordic Semiconductor ASA
#
# SPDX-License-Identifier: LicenseRef-Nordic-5-Clause
#


config NRF_AXON_MFCC
	bool "Enable Axon Accelerated MFCC Calculation"
	depends on NRF_AXON
	help
	  Enables the base Axon MFCC calculation. Caller is responsible for managing the input
	  and output and scheduling of MFCC calculation. 

config NRF_AXON_MFCC_NAME
	string "Name of the mfcc implementation to use"
	depends on NRF_AXON_MFCC
```

## lib/axon/zephyr/Kconfig.nrf_axon
```kconfig
#
# Copyright (c) 2024 Nordic Semiconductor ASA
#
# SPDX-License-Identifier: LicenseRef-Nordic-5-Clause
#
rsource "../drivers/axon/Kconfig"
orsource "../lib/axon/mfcc/zephyr/Kconfig.nrf_axon"
orsource "../internal/zephyr/Kconfig.nrf_axon"
```

## lib/bsp/Kconfig
```kconfig
# BSP Kconfig options

config BSP_DMIC_BUFFER_BLOCKS
	int "Number of DMIC memory slab blocks"
	default 4
	help
	  Number of memory slab blocks allocated for DMIC buffering.
	  Increase for applications that need to tolerate slow processing,
	  such as applications with synchronous debug prints.

config BSP_LEDS
	bool "BSP LED support"
	depends on GPIO
	default n
	help
	  Enable LED control functions from the BSP library.
```
