## CMakeLists.txt
```
#
# Copyright (c) 2024, Nordic Semiconductor ASA. All Rights Reserved.
#
# The information contained herein is confidential property of Nordic Semiconductor ASA.
# The use, copying, transfer or disclosure of such information is prohibited except by
# express written agreement with Nordic Semiconductor ASA.
#
cmake_minimum_required(VERSION 3.20.0)

set(CMAKE_COMPILE_WARNING_AS_ERROR ON)

find_package(Zephyr REQUIRED HINTS $ENV{ZEPHYR_BASE})
project(axon_intrinsics VERSION 0.1.0 LANGUAGES C)

	target_sources(app PRIVATE
		src/axon_app_intrinsics_zephyr.c
		src/axon_app_intrinsics.c
	)
```

## prj.conf
```kconfig
CONFIG_PRINTK=y
CONFIG_LOG=y
CONFIG_LOG_MODE_IMMEDIATE=y

CONFIG_NRF_AXON=y

CONFIG_OUTPUT_DISASSEMBLY=y
CONFIG_OUTPUT_DISASSEMBLE_ALL=y

CONFIG_MAIN_STACK_SIZE=4096

CONFIG_DEBUG_OPTIMIZATIONS=n
```

## src/axon_app_intrinsics_zephyr.c
```c
/*
 * Copyright (c) 2022 Nordic Semiconductor ASA
 *
 * SPDX-License-Identifier: LicenseRef-Nordic-5-Clause
 */

#include <zephyr/kernel.h>
#include <zephyr/irq.h>
#include <zephyr/sys_clock.h>
#include <zephyr/sys/printk.h>

#include <zephyr/logging/log.h>

// #define MY_LOG_LEVEL LOG_LEVEL_NONE
#define MY_LOG_LEVEL LOG_LEVEL_DBG

LOG_MODULE_REGISTER(kws, MY_LOG_LEVEL);

extern void main_intrinsics_test(void);
int main(void)
{
  while (1) {
    printk("axon_fe_mfcc on %s\n", CONFIG_BOARD);

    // Start inference
    main_intrinsics_test();

    k_sleep(K_FOREVER);
  }
  return 0;
}
```
