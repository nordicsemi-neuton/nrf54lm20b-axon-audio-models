## CMakeLists.txt
```
# SPDX-License-Identifier: Apache-2.0

cmake_minimum_required(VERSION 3.20.0)

# Include application-specific Kconfig before finding Zephyr
set(KCONFIG_ROOT ${CMAKE_CURRENT_SOURCE_DIR}/Kconfig)

find_package(Zephyr REQUIRED HINTS $ENV{ZEPHYR_BASE})
project(snoring_detection)

# Note: The nrf_edgeai library is linked directly in zephyr/CMakeLists.txt using zephyr_link_libraries(),
# and the axon SDK sources and libraries are added directly to Zephyr via zephyr_sources() in the same CMakeLists.txt.

target_sources(app PRIVATE
    src/main.cpp
    src/nrf_edgeai_generated/nrf_edgeai_user_model.c
)
```

## sample.yaml
```
sample:
  description: Continuous PDM microphone snoring detection using an nRF Edge AI model with rolling confidence postprocessing and LED alert.
  name: Snoring Detection Application

common:
  sysbuild: true
  build_only: true
  tags:
    - axon
    - axon_audio_models
    - axon_snoring_detection

tests:
  applications.snoring_detection.zdebug:
    platform_allow:
      - nrf54lm20dk/nrf54lm20b/cpuapp
    integration_platforms:
      - nrf54lm20dk/nrf54lm20b/cpuapp
```

## prj.conf
```kconfig
# General project configuration for the snoring detection application
CONFIG_CPP=y
CONFIG_STD_CPP17=y
CONFIG_REQUIRES_FULL_LIBCPP=y
CONFIG_NEWLIB_LIBC=y
CONFIG_NEWLIB_LIBC_FLOAT_PRINTF=y
CONFIG_NEWLIB_LIBC_NANO=n
CONFIG_FPU=y

# Set the main thread stack size to accommodate the needs of the application
CONFIG_MAIN_STACK_SIZE=8192

# Enable PDM microphone support
CONFIG_AUDIO=y
CONFIG_AUDIO_DMIC=y

# Enable GPIO support for the button and LED libraries
CONFIG_GPIO=y

# Enable logging for debugging purposes
CONFIG_LOG=y
CONFIG_LOG_MODE_IMMEDIATE=y
CONFIG_PRINTK=y
CONFIG_PRINTK_SYNC=y

# Enable verbose assertions for better debugging information
CONFIG_ASSERT_VERBOSE=y

# Enable the Nordic Semiconductor AXON neural network accelerator
CONFIG_NRF_AXON=y

# BSP options
CONFIG_BSP_LEDS=y

# Axon model specific settings
CONFIG_NRF_AXON_INTERLAYER_BUFFER_SIZE=6048
CONFIG_NRF_AXON_PSUM_BUFFER_SIZE=0
```

## src/main.cpp
```c
#include <zephyr/kernel.h>
#include <zephyr/sys/__assert.h>
#include <nrf_edgeai/nrf_edgeai.h>

#include "nrf_edgeai_generated/nrf_edgeai_user_model.h"
#include "dmic.h"
#include "leds.h"

//////////////////////////////////////////////////////////////////////////////

#define CONFIDENCE_THRESHOLD      0.68f
#define PREDICTION_NUM_IN_ROW     20
#define MAX_PREDICTION_NUM_IN_ROW 31
#define PRINT_RAW_PROBABILITY     0

//////////////////////////////////////////////////////////////////////////////

static bool snoring_detection_postprocessing(nrf_edgeai_t* p_model);

//////////////////////////////////////////////////////////////////////////////

int main()
{
    printk("Starting Snoring Detection Application...\n");
    printk("Model postprocessig adjustable parameters:\n");
    printk("\tconfidence threshold: %f,\n"
           "\tnumber of predictions in row: %d\n",
           CONFIDENCE_THRESHOLD,
           PREDICTION_NUM_IN_ROW);

    __ASSERT(PREDICTION_NUM_IN_ROW < MAX_PREDICTION_NUM_IN_ROW,
             "Number of predictions in row should be less than %d to fit in the bitmask used for "
             "postprocessing",
             MAX_PREDICTION_NUM_IN_ROW);

    nrf_edgeai_rt_version_t libver = nrf_edgeai_runtime_version();
    printk("Nordic Edge AI Library version: %d.%d.%d\n",
           libver.field.major,
           libver.field.minor,
           libver.field.patch);

    // Get pointer to the Edge AI model instance
    nrf_edgeai_t* p_model = nrf_edgeai_user_model();

    // Initialize snoring model
    nrf_edgeai_err_t res = nrf_edgeai_init(p_model);
    __ASSERT(res == NRF_EDGEAI_ERR_SUCCESS,
             "Failed to initialize Edge AI model, error code: %d\n",
             res);
    // Initialize PDM microphone and LEDs
    int err = dmic_init();
    __ASSERT(err == 0, "Failed to initialize DMIC, error code: %d\n", err);

    err = leds_init();
    __ASSERT(err == 0, "Failed to initialize LEDs, error code: %d\n", err);

    printk("Initialization completed!\n");
    printk("Listening Audio Environment for snoring ...\n");

    err = dmic_start();
    __ASSERT(err == 0, "Failed to start DMIC, error code: %d\n", err);

    void*         audio_buffer;
    size_t        audio_buffer_size;
    const int32_t read_timeout = 100;

    while (true)
    {
        // Read audio data from DMIC,
        err = dmic_read_buffer(&audio_buffer, &audio_buffer_size, read_timeout);
        if (err < 0)
        {
            printk("Failed to read from DMIC (err %d)\n", err);
            continue;
        }

        size_t samples_num = audio_buffer_size / DMIC_SAMPLE_BYTES;

        // Feed audio data to the model dsp pipeline and
        // waiting for internal buffers to be filled with enough data for feature extraction
        res = nrf_edgeai_feed_inputs(p_model, audio_buffer, samples_num);
        dmic_free_buffer(audio_buffer);

        if (res != NRF_EDGEAI_ERR_SUCCESS) { continue; }

        // Run feature extraction and model inference
        res = nrf_edgeai_run_inference(p_model);

        if (res != NRF_EDGEAI_ERR_SUCCESS) { continue; }

        // Run postprocessing on the model output to determine if snoring is detected based on the model inference results
        if (snoring_detection_postprocessing(p_model))
        {
            printk("Snoring detected! \n");
            leds_blink_led0();
        }
    }

    return 0;
}

//////////////////////////////////////////////////////////////////////////////

static bool snoring_detection_postprocessing(nrf_edgeai_t* p_model)
{
    // Rolling postprocessing state kept across calls.
    // - predicitons_history stores recent boolean detections as bits (newest at bit 0).
    // - prediction_count tracks how many `1` bits are currently in the window.
    static uint32_t prediction_count;
    static uint32_t predicitons_history;

    // Read model confidence for the currently predicted class.
    const uint16_t predicted_class = p_model->decoded_output.classif.predicted_class;
    const float probability = p_model->decoded_output.classif.probabilities.p_f32[predicted_class];

    // Convert probability to a binary detection for this frame.
    const bool detected = probability > CONFIDENCE_THRESHOLD;

    // Check the bit that will fall out of the window after the left shift.
    // MAX_PREDICTION_NUM_IN_ROW is the history bit-width limit used by this algorithm.
    const bool oldest_entry = (bool)(predicitons_history & BIT(MAX_PREDICTION_NUM_IN_ROW));

    // Update rolling count in O(1): add newest detection, remove oldest.
    prediction_count = prediction_count + detected - oldest_entry;
    // Shift history left and append current detection at LSB.
    predicitons_history = (predicitons_history << 1) | detected;

#if PRINT_RAW_PROBABILITY
    printk("Predictions count: %2u, probability: %0.3f\n", prediction_count, probability);
#endif

    if (prediction_count >= PREDICTION_NUM_IN_ROW)
    {
        // Enough positive frames accumulated: emit one detection event
        // and clear state to avoid repeated triggers from stale history.
        prediction_count    = 0;
        predicitons_history = 0;

        return true;
    }

    return false;
}
```

## src/dmic.c
```c
/*
 * Copyright (c) 2026 Nordic Semiconductor ASA
 *
 * SPDX-License-Identifier: LicenseRef-Nordic-5-Clause
 */

#include <stddef.h>

#include <zephyr/audio/dmic.h>
#include <zephyr/device.h>
#include <zephyr/devicetree.h>
#include <zephyr/kernel.h>

#include "dmic.h"

//////////////////////////////////////////////////////////////////////////////

#define BLOCK_SIZE (DMIC_SAMPLE_BYTES * DMIC_PCM_RATE * SAMPLES_BLOCK_LENGTH_MS / 1000)

K_MEM_SLAB_DEFINE_STATIC(dmic_mem_slab, BLOCK_SIZE, 4, 4);
static const struct device* const dmic_dev = DEVICE_DT_GET(DT_NODELABEL(dmic_dev));

//////////////////////////////////////////////////////////////////////////////

int dmic_init(void)
{
    int err;

    if (!device_is_ready(dmic_dev))
    {
        printk("Device is not ready\n");
        return -ENODEV;
    }

    struct pcm_stream_cfg stream = {
        .pcm_rate   = DMIC_PCM_RATE,
        .pcm_width  = DMIC_SAMPLE_BYTES * 8,
        .block_size = BLOCK_SIZE,
        .mem_slab   = &dmic_mem_slab,
    };
    struct dmic_cfg cfg = {
		.io = {
			.min_pdm_clk_freq = 1000000,
			.max_pdm_clk_freq = 3250000,
			.min_pdm_clk_dc = 40,
			.max_pdm_clk_dc = 60,
		},
		.streams = &stream,
		.channel = {
			.req_chan_map_lo = dmic_build_channel_map(0, 0, PDM_CHAN_LEFT),
			.req_chan_map_hi = 0,
			.req_num_chan = 1,
			.req_num_streams = 1,
		},
	};

    err = dmic_configure(dmic_dev, &cfg);
    if (err < 0)
    {
        printk("Failed to configure (err %d)\n", err);
        return err;
    }

    return 0;
}

//////////////////////////////////////////////////////////////////////////////

int dmic_start(void)
{
    return dmic_trigger(dmic_dev, DMIC_TRIGGER_START);
}

//////////////////////////////////////////////////////////////////////////////

int dmic_read_buffer(void** audio_buffer, size_t* audio_buffer_size, int32_t timeout_ms)
{
    return dmic_read(dmic_dev, 0, audio_buffer, audio_buffer_size, timeout_ms);
}

//////////////////////////////////////////////////////////////////////////////
void dmic_free_buffer(void* buffer)
{
    k_mem_slab_free(&dmic_mem_slab, buffer);
}
```
